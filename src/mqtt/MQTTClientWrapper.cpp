#include "MQTTClientWrapper.h"

// Arduino-hardware-specific includes — excluded from native build via build_src_filter
#include <Arduino.h>
#include <Ethernet.h>
#include <ESP_SSLClient.h>
#include <PubSubClient.h>

// Trust anchors generated by scripts/gen_certs.py
// Generate before first build: python scripts/gen_certs.py <ca.crt>
#if __has_include("../config/trust_anchors.h")
#include "../config/trust_anchors.h"
#else
// Placeholder until gen_certs.py has been run
const br_x509_trust_anchor TAs[0] = {};
const int TAs_NUM = 0;
#endif

static EthernetClient  _ethClient;
static ESP_SSLClient   _sslClient;
static PubSubClient    _mqttClient;

MQTTClientWrapper::MQTTClientWrapper(const DeviceConfig& cfg, const RuntimeConfig& rt)
    : _cfg(cfg)
    , _rt(rt)
    , _state(ConnState::Disconnected)
    , _backoffMs(BACKOFF_INITIAL_MS)
    , _lastAttemptMs(0)
    , _justReconnected(false)
    , _reconnectCb(nullptr)
    , _reconnectCtx(nullptr)
{}

void MQTTClientWrapper::begin() {
    _sslClient.setClient(_ethClient);
    _sslClient.setTrustAnchors(TAs, TAs_NUM);
    _mqttClient.setClient(_sslClient);
    _mqttClient.setServer(_cfg.mqtt.broker_host, _cfg.mqtt.broker_port);
    _mqttClient.setKeepAlive(_cfg.mqtt.keepalive_s > 0 ? _cfg.mqtt.keepalive_s : 60);
    _mqttClient.setSocketTimeout(_cfg.mqtt.socket_timeout_s > 0 ? _cfg.mqtt.socket_timeout_s : 15);
    _mqttClient.setBufferSize(1024);
}

void MQTTClientWrapper::loop() {
    _justReconnected = false;

    switch (_state) {
    case ConnState::Disconnected:
        _state = ConnState::Connecting;
        _lastAttemptMs = ::millis();
        if (attemptConnect()) {
            onConnected();
        } else {
            _state = ConnState::Backoff;
        }
        break;

    case ConnState::Connecting:
        // Handled inline in Disconnected case; shouldn't linger here
        break;

    case ConnState::Connected:
        _mqttClient.loop();
        if (!_mqttClient.connected()) {
            _state     = ConnState::Backoff;
            _backoffMs = BACKOFF_INITIAL_MS;
        }
        break;

    case ConnState::Backoff:
        if (::millis() - _lastAttemptMs >= _backoffMs) {
            _state = ConnState::Connecting;
            _lastAttemptMs = ::millis();
            if (attemptConnect()) {
                onConnected();
            } else {
                // Exponential backoff, capped
                _backoffMs = (_backoffMs * 2 > BACKOFF_MAX_MS) ? BACKOFF_MAX_MS : _backoffMs * 2;
                _state = ConnState::Backoff;
                _lastAttemptMs = ::millis();
            }
        }
        break;
    }
}

bool MQTTClientWrapper::attemptConnect() {
    const char* clientId = (_cfg.mqtt.client_id && _cfg.mqtt.client_id[0])
                           ? _cfg.mqtt.client_id
                           : _cfg.device_id;

    // LWT: publish "offline" to availability topic on unexpected disconnect
    char lwtTopic[128];
    snprintf(lwtTopic, sizeof(lwtTopic), "%s/availability", _cfg.mqtt.topic_root);

    return _mqttClient.connect(
        clientId,
        _rt.mqtt_username[0] ? _rt.mqtt_username : nullptr,
        _rt.mqtt_password[0] ? _rt.mqtt_password : nullptr,
        lwtTopic,
        0,    // QoS
        true, // retain
        "offline"
    );
}

void MQTTClientWrapper::onConnected() {
    _state           = ConnState::Connected;
    _backoffMs       = BACKOFF_INITIAL_MS;
    _justReconnected = true;

    // Publish device availability
    char avail[128];
    snprintf(avail, sizeof(avail), "%s/availability", _cfg.mqtt.topic_root);
    _mqttClient.publish(avail, "online", true);

    if (_reconnectCb) _reconnectCb(_reconnectCtx);
    drainBuffer();
}

void MQTTClientWrapper::drainBuffer() {
    BufferedMessage msg;
    while (_buffer.pop(msg)) {
        _mqttClient.publish(msg.topic, msg.payload, msg.retain);
    }
}

bool MQTTClientWrapper::publish(const char* topic, const char* payload, bool retain) {
    if (_state == ConnState::Connected) {
        return _mqttClient.publish(topic, payload, retain);
    }
    return _buffer.push(topic, payload, retain, 0);
}

bool MQTTClientWrapper::subscribe(const char* topic) {
    if (_state != ConnState::Connected) return false;
    return _mqttClient.subscribe(topic);
}

void MQTTClientWrapper::onReconnect(ReconnectCallback cb, void* context) {
    _reconnectCb  = cb;
    _reconnectCtx = context;
}

void MQTTClientWrapper::setMessageCallback(void (*callback)(const char*, uint8_t*, unsigned int)) {
    _mqttClient.setCallback(callback);
}
